## conf/layer.conf
```bitbake
# We have a conf and classes directory, add to BBPATH
BBPATH .= ":${LAYERDIR}"

# We have a recipes-* directories, add to BBFILES
BBFILES := "${LAYERDIR}/recipes-*/*/*.bb \
			${LAYERDIR}/recipes-*/*/*.bbappend"

BBFILE_COLLECTIONS += "edison"
BBFILE_PATTERN_edison = "^${LAYERDIR}/"
BBFILE_PRIORITY_edison = "9"

MACHINE_ESSENTIAL_EXTRA_RDEPENDS_append_edison = " systemd-watchdog"

MACHINE_ESSENTIAL_EXTRA_RDEPENDS_append_edison = " \
    i2c-edison-board \
"
```

## conf/machine/edison.conf
```bitbake
#@TYPE: Machine
#@NAME: edison
#@DESCRIPTION: Machine configuration for edison systems

DEFAULTTUNE ?= "edison"
require conf/machine/include/tune-edison.inc
include conf/machine/include/edison-base.inc

SERIAL_CONSOLES ?= "115200;ttyMFD2 115200;ttyGS0"

UBOOT_MACHINE = "edison_config"

# we want rootfs size of 2097152
# rootfs_rpm.bbclass adds 51200
# so adjust to 2097152 - 51200
IMAGE_ROOTFS_SIZE = "2045952"

#INITRAMFS_IMAGE ?= "core-image-initramfs-edison"
#INITRAMFS_IMAGE_BUNDLE ?= "1"

# Also, Ostro OS is not allowed to ask for additional space either.
# TODO: this should be a variable from OE-core which gets
# added by rootfs_rpm.bbclass, instead of doing the increase twice
# and having to substract the 51200 value above.
#OSTRO_IMAGE_ROOTFS_EXTRA_SPACE = ""
```

## conf/machine/include/edison-base.inc
```bitbake
include conf/machine/include/edison-default-settings.inc
include conf/machine/include/edison-default-versions.inc
include conf/machine/include/edison-default-providers.inc

X86ARCH32 ?= "i686"
require conf/machine/include/x86/arch-x86.inc

IMAGE_FSTYPES = "tar.bz2 ext4 toflash"

XSERVER = "xserver-xorg \
           xf86-input-keyboard \
           xf86-input-evdev \
           xf86-video-dummy \
"


KERNEL_IMAGETYPE = "bzImage"
MACHINE_FEATURES = "bluetooth alsa pci serial usbgadget usbhost wifi x86 ext3"
MACHINE_ESSENTIAL_EXTRA_RDEPENDS += "bluetooth-rfkill-event"
MACHINE_ESSENTIAL_EXTRA_RRECOMMENDS += "u-boot-edison u-boot-fw-utils-edison kernel-modules sst-fw mcu-fw-bin mcu-fw-load"
MACHINE_ESSENTIAL_EXTRA_RRECOMMENDS += "kernel-module-bcm-bt-lpm bcm43340-bt"
MACHINE_ESSENTIAL_EXTRA_RRECOMMENDS += "bcm43340-mod bcm43340-fw"
MACHINE_ESSENTIAL_EXTRA_RRECOMMENDS += "kernel-module-g-multi"
```

## conf/machine/include/edison-default-versions.inc
```bitbake
# Edison BSP default versions
PREFERRED_VERSION_linux-yocto-edison = "3.10%"
PREFERRED_VERSION_u-boot-edison ?= "2014.04-1"
PREFERRED_VERSION_u-boot-fw-utils-edison ?= "2014.04-1"
```

## conf/machine/include/tune-edison.inc
```bitbake
DEFAULTTUNE ?= "edison"

TUNEVALID[edison] = "Enable Edison specific processor optimizations"
TUNE_CCARGS .= "${@bb.utils.contains('TUNE_FEATURES', 'edison', ' -march=atom -msse3 -mfpmath=sse', '', d)}"

AVAILTUNES += "edison"
TUNE_PKGARCH_tune-edison = "edison"
TUNE_FEATURES_tune-edison = "${TUNE_FEATURES_tune-x86} edison"
BASE_LIB_tune-edison = "lib"
#PACKAGE_EXTRA_ARCHS_tune-edison = "${PACKAGE_EXTRA_ARCHS_tune-x86} edison"
```
